## 1_XAIO_SW/code/components/icvsp_ble/Kconfig
```kconfig
menu "ICVSP BLE test (T-016)"

config ICVSP_BLE_DEVICE_NAME
    string "Advertised name"
    default "ICVSP-001"

config ICVSP_BLE_RETRY_MS
    int "Milliseconds without ACK before the report is sent again"
    default 2000
    range 500 30000

config ICVSP_BLE_MAX_ATTEMPTS
    int "Attempts per report before it stalls (a late ACK is still accepted)"
    default 3
    range 1 10

config ICVSP_BLE_REPORT_GAP_MS
    int "Milliseconds between an ACK and the next test report"
    default 10000
    range 0 600000

endmenu
```

## 1_XAIO_SW/code/components/icvsp_camera/Kconfig
```kconfig
menu "ICVSP camera test (T-012)"

config ICVSP_CAM_LIGHTING
    string "Light during this run (printed in the log and the photo headers)"
    default "not recorded"
    help
        Write the light before each run, for example "bright room", "dim room", "lens covered".
        Easiest: idf.py menuconfig, or add CONFIG_ICVSP_CAM_LIGHTING="dim room" to sdkconfig.local.

config ICVSP_CAM_SHOTS
    int "Photos per resolution"
    default 20
    range 1 200

config ICVSP_CAM_WARMUP_FRAMES
    int "Frames thrown away after each start (exposure settling)"
    default 3
    range 0 20

config ICVSP_CAM_INIT_ATTEMPTS
    int "Camera start attempts before the start counts as failed"
    default 3
    range 1 10

config ICVSP_CAM_MIN_JPEG_BYTES
    int "Smaller frames count as broken (bytes)"
    default 512

config ICVSP_CAM_LEAK_TOLERANCE
    int "Bytes of RAM allowed to be missing after the camera stops"
    default 4096

config ICVSP_CAM_DUMP_JPEG
    bool "Print one QVGA and one VGA photo as Base64 (for extract_jpegs.py)"
    default y

config ICVSP_CAM_PRINT_EVERY_SHOT
    bool "Print one line per photo (size, markers, wait time)"
    default y

endmenu
```

## 1_XAIO_SW/code/components/icvsp_gnss/Kconfig
```kconfig
menu "ICVSP GNSS test (T-014)"

config ICVSP_GNSS_PRINT_EVERY_MS
    int "Milliseconds between status or fix lines"
    default 1000
    range 200 10000

config ICVSP_GNSS_PRINT_COORDS
    bool "Print latitude and longitude (private: off for logs that are saved or shared)"
    default n
    help
        Off: FIX lines show lat=hidden lon=hidden, so saved logs never show where the test was done.
        Turn it on only for a private check, and do not save or share that log.

config ICVSP_GNSS_COORD_DECIMALS
    int "Decimals printed for latitude and longitude"
    depends on ICVSP_GNSS_PRINT_COORDS
    default 7
    range 0 7

config ICVSP_GNSS_SOFTWARE_TESTS
    bool "Keys S and D in the monitor simulate stale data and a lost UART for 6 s"
    default y

config ICVSP_GNSS_DEBUG_EVERY_S
    int "Seconds between GNSS DEBUG lines (byte and sentence counters); 0 = off"
    default 10
    range 0 600

endmenu
```

## 1_XAIO_SW/code/components/icvsp_imu/Kconfig
```kconfig
menu "ICVSP IMU test (T-010)"

config ICVSP_IMU_PERIOD_MS
    int "Milliseconds between readings"
    default 200
    range 10 5000

config ICVSP_IMU_RETRY_MS
    int "Milliseconds between retries while the sensor is lost or missing"
    default 1000
    range 100 10000

config ICVSP_IMU_PRINT_EVERY_READING
    bool "Print every reading (off: one short line every 25 readings)"
    default y

endmenu
```

## 1_XAIO_SW/code/main/Kconfig.projbuild
```kconfig
menu "ICVSP ECU"

choice ICVSP_BUILD_TYPE
    prompt "Build type"
    default ICVSP_BUILD_TEST
    help
        Set by the build type's sdkconfig layer (sdkconfig.prod, sdkconfig.dev); the one-part test firmwares are
        "test". See 1_XAIO_SW/doc/BUILD_AND_FLASH.md.
    config ICVSP_BUILD_PRODUCTION
        bool "Production: the all-in-one firmware that goes in the car"
    config ICVSP_BUILD_DEV
        bool "Development: the same firmware with extra debug checks"
    config ICVSP_BUILD_TEST
        bool "Test: one part at a time, for the board test cases"
endchoice

choice ICVSP_APP
    prompt "Firmware to build"
    default ICVSP_APP_SMOKE
    config ICVSP_APP_SMOKE
        bool "Boot/sensor smoke test"
    config ICVSP_APP_REPORT_DEMO
        bool "Signed report demo: ECU app -> POST /reports over the network"
    config ICVSP_APP_CAMERA
        bool "T-012 camera bring-up test (no Wi-Fi needed)"
    config ICVSP_APP_IMU
        bool "T-010 MPU6050 IMU bring-up test (no Wi-Fi needed)"
    config ICVSP_APP_GNSS
        bool "T-014 L76K GNSS bring-up test (no Wi-Fi needed)"
    config ICVSP_APP_BLE
        bool "T-016 BLE GATT bring-up test (no Wi-Fi needed)"
    config ICVSP_APP_ECU
        bool "All-in-one ECU: IMU, GNSS, camera, BLE (and Wi-Fi) running together"
endchoice

config ICVSP_ECU_CAMERA_PERIOD_MS
    int "All-in-one ECU: milliseconds between camera photos"
    depends on ICVSP_APP_ECU
    default 5000
    range 500 60000

choice ICVSP_ECU_IMU_MOUNT
    prompt "All-in-one ECU: how the IMU sits in the car (z must point up)"
    depends on ICVSP_APP_ECU
    default ICVSP_ECU_IMU_FLAT_X_FORWARD
    config ICVSP_ECU_IMU_FLAT_X_FORWARD
        bool "Flat, the sensor's X arrow points to the front of the car"
    config ICVSP_ECU_IMU_FLAT_Y_FORWARD
        bool "Flat, the sensor's Y arrow points to the front of the car"
endchoice

config ICVSP_GPS_LISTEN_S
    int "Seconds to listen to the GPS UART"
    default 5
    range 2 60

config ICVSP_WIFI_SSID
    string "Wi-Fi network name (set it in sdkconfig.local, not in git)"
    default ""

config ICVSP_WIFI_PASSWORD
    string "Wi-Fi password (set it in sdkconfig.local, not in git)"
    default ""

config ICVSP_REPORT_URL
    string "Backend POST /reports URL"
    default "http://10.0.2.2:8010/reports"
    help
        The backend's POST /reports URL: the laptop's LAN address for a local backend, or the
        AWS https:// URL. Set it in sdkconfig.local.

config ICVSP_TLS_REQUIRE_1_3
    bool "HTTPS: require TLS 1.3 (offer no older version)"
    depends on MBEDTLS_SSL_PROTO_TLS1_3
    default y
    help
        Matches FR-SEC-08 (TLS 1.3 to the backend; written for the phone/app link). The ECU then offers only TLS 1.3, so a server (or a
        man-in-the-middle) that only speaks TLS 1.2 gets no connection. AWS Lambda function URLs accept TLS 1.3.

config ICVSP_SNTP_SERVER
    string "SNTP server (report demo clock; on the road the clock comes from GNSS)"
    default "pool.ntp.org"

config ICVSP_DEMO_LAT
    string "Report demo: latitude of the simulated drive (degrees)"
    default "30.0444"
    help
        Start of the simulated GNSS route (the demo drives east from here). Default: Cairo.

config ICVSP_DEMO_LON
    string "Report demo: longitude of the simulated drive (degrees)"
    default "31.2357"

config ICVSP_DEVICE_ID
    string "Device ID registered in the backend (empty: ecu-<MAC address>)"
    default ""
    help
        Leave empty on every board: the ID is then made from the chip's factory MAC address, so each ECU has
        its own without per-board settings.

choice ICVSP_KEY_SOURCE
    prompt "Signing key"
    default ICVSP_KEY_PER_DEVICE
    config ICVSP_KEY_PER_DEVICE
        bool "Per device: made on the chip at first boot (hardware RNG), kept in NVS"
    config ICVSP_KEY_DEMO_SEED
        bool "Demo seed from sdkconfig.local (same key on every board; demos only)"
        depends on !ICVSP_BUILD_PRODUCTION
endchoice

config ICVSP_DEMO_SEED_HEX
    string "Demo signing seed, 64 hex characters (sdkconfig.local only; a demo key, not a production key)"
    depends on ICVSP_KEY_DEMO_SEED
    default ""

endmenu
```

## firmware/ecu/main/Kconfig.projbuild
```kconfig
menu "ICVSP ECU"

choice ICVSP_APP
    prompt "Firmware to build"
    default ICVSP_APP_SMOKE
    config ICVSP_APP_SMOKE
        bool "Boot/sensor smoke test"
    config ICVSP_APP_REPORT_DEMO
        bool "Signed report demo: ECU app -> POST /reports over the network"
    config ICVSP_APP_WIFI_HOTSPOT
        bool "Wi-Fi hotspot station test"
endchoice

config ICVSP_SMOKE_EMULATOR
    bool "Built for QEMU: skip the probes that need real hardware"
    default n
    help
        Set by sdkconfig.qemu. The camera, IMU and GPS probes are reported as SKIP instead of FAIL.

config ICVSP_GPS_LISTEN_S
    int "Seconds to listen to the GPS UART"
    default 5
    range 2 60

config ICVSP_NET_QEMU_ETH
    depends on !ICVSP_APP_WIFI_HOTSPOT
    bool "Network over QEMU's emulated Ethernet instead of Wi-Fi (emulator only)"
    default n
    help
        Set by sdkconfig.report_qemu. QEMU has no Wi-Fi radio; it emulates an OpenCores Ethernet port.

config ICVSP_WIFI_SSID
    string "Wi-Fi network name (set it in sdkconfig.local, not in git)"
    default ""

config ICVSP_WIFI_PASSWORD
    string "Wi-Fi password (set it in sdkconfig.local, not in git)"
    default ""

config ICVSP_REPORT_URL
    string "Backend POST /reports URL"
    default "http://10.0.2.2:8010/reports"
    help
        10.0.2.2 is the laptop as seen from inside QEMU. On the board: the laptop's LAN address, later the
        Cloud Run https:// URL.

config ICVSP_TLS_REQUIRE_1_3
    bool "HTTPS: require TLS 1.3 (offer no older version)"
    depends on MBEDTLS_SSL_PROTO_TLS1_3
    default y
    help
        Matches FR-SEC-08 (TLS 1.3 to the backend; written for the phone/app link). The ECU then offers only TLS 1.3, so a server (or a
        man-in-the-middle) that only speaks TLS 1.2 gets no connection. AWS Lambda function URLs accept TLS 1.3.

config ICVSP_TLS_TEST_CA
    bool "HTTPS test build: trust only the test CA in tls_test/ca.pem (not the public root bundle)"
    default n
    help
        Set by sdkconfig.report_tls for the certificate tests against the laptop backend. Never on a real
        deployment: there the server certificate is checked against ESP-IDF's public root bundle.

config ICVSP_SNTP_SERVER
    string "SNTP server (report demo clock; on the road the clock comes from GNSS)"
    default "pool.ntp.org"

config ICVSP_DEMO_LAT
    string "Report demo: latitude of the simulated drive (degrees)"
    default "30.0444"
    help
        Start of the simulated GNSS route (the demo drives east from here). Default: Cairo. Runs against the
        shared cloud database use the team's test location in the Western Desert (sdkconfig.report_aws).

config ICVSP_DEMO_LON
    string "Report demo: longitude of the simulated drive (degrees)"
    default "31.2357"

config ICVSP_DEVICE_ID
    string "Device ID registered in the backend (empty: ecu-<MAC address>)"
    default ""
    help
        Leave empty on every board: the ID is then made from the chip's factory MAC address, so each ECU has
        its own without per-board settings.

choice ICVSP_KEY_SOURCE
    prompt "Signing key"
    default ICVSP_KEY_PER_DEVICE
    config ICVSP_KEY_PER_DEVICE
        bool "Per device: made on the chip at first boot (hardware RNG), kept in NVS"
    config ICVSP_KEY_DEMO_SEED
        bool "Demo seed from sdkconfig.local (same key on every board; demos only)"
endchoice

config ICVSP_DEMO_SEED_HEX
    string "Demo signing seed, 64 hex characters (sdkconfig.local only; a demo key, not a production key)"
    depends on ICVSP_KEY_DEMO_SEED
    default ""

endmenu
```
