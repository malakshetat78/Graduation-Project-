## firmware/ble/main/Kconfig.projbuild
```kconfig
menu "ICVSP BLE"
config ICVSP_TRANSPORT_DEMO
    bool "Queue one UNSIGNED 706-byte transport test at boot"
    default n
    help
        Diagnostic only; contains no signature and must never be accepted as a hazard.
endmenu
```

## firmware/ble/sdkconfig.defaults
```kconfig
CONFIG_BT_ENABLED=y
CONFIG_BT_NIMBLE_ENABLED=y
CONFIG_BT_NIMBLE_ROLE_PERIPHERAL=y
CONFIG_BT_NIMBLE_ROLE_BROADCASTER=y
CONFIG_BT_NIMBLE_MAX_CONNECTIONS=1
CONFIG_BT_NIMBLE_ATT_PREFERRED_MTU=247
CONFIG_ESP_CONSOLE_USB_SERIAL_JTAG=y
```

## firmware/espidf_security/main/Kconfig.projbuild
```kconfig
menu "ICVSP secure storage"
    config ICVSP_ENABLE_SECURE_NVS
        bool "Enable pre-provisioned HMAC-backed encrypted key storage (hardware only)"
        default n
        help
            Do NOT enable until the selected eFuse key block is verified and
            provisioned with HMAC_UP. No eFuse key generation is performed.
    config ICVSP_HMAC_KEY_ID
        int "Pre-provisioned HMAC eFuse key index (0-5)"
        range -1 5
        default -1
        help
            Leave at -1 until physical board key slot is verified.
endmenu
```

## firmware/espidf_security/sdkconfig.defaults
```kconfig
CONFIG_IDF_TARGET="esp32s3"
CONFIG_ESPTOOLPY_FLASHSIZE_8MB=y
CONFIG_ESPTOOLPY_FLASHSIZE="8MB"
CONFIG_PARTITION_TABLE_CUSTOM=y
CONFIG_PARTITION_TABLE_CUSTOM_FILENAME="partitions.csv"
CONFIG_ICVSP_ENABLE_SECURE_NVS=n
CONFIG_ICVSP_HMAC_KEY_ID=-1
```
